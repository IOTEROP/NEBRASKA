## esp32_nebraska/main/Kconfig.projbuild
```kconfig
menu "Nebraska sample configuration"

    config NEBRASKA_TARGET_DOMAIN_URI
        string "Target Uri"
        default "coaps://ingress.nebraska.ioterop.com:18834"
        help
            Target uri for NEBRASKA Server

    config DEMO_NEBRASKA_PSK_KEY
        string "Preshared Key (PSK) to used in the connection to the CoAP server"
        depends on COAP_MBEDTLS_PSK
        default "abcdef"
        help
            The Preshared Key to use to encrypt the communicatons. The same key must be
            used at both ends of the CoAP connection, and the CoaP client must request
            an URI prefixed with coaps:// instead of coap:// for DTLS to be used.

    config DEMO_NEBRASKA_PSK_IDENTITY
        string "PSK Client identity (username)"
        depends on COAP_MBEDTLS_PSK
        default "MqttIdentity"
        help
            The identity (or username) to use to identify to the CoAP server which
            PSK key to use.
			
    config DEMO_NEBRASKA_ENDPOINT
        string "Client endpoint"
        default "Nebraska_client_1"
        help
            The identity (or endpoint name) to use to identify the client.
			
    config DEMO_NEBRASKA_TOPIC
        string "Topic name"
        default "/demo/test_1"
        help
            The topic to use.
			
	config DEMO_NEBRASKA_QOS
        int "QoS"
        default 0
        help
            The QoS value to set (-1 to be ignored).
			
	config DEMO_NEBRASKA_KEEPALIVE
        int "Keepalive value"
        default 120
        help
            Keepalive value to set (-1 to be ignored).
			
	config DEMO_NEBRASKA_RFLAGS
        int "Retain flag value"
        default 1
        help
            Retain flag value to set (-1 to be ignored).
			
endmenu
```

## nrf9160dk/Kconfig
```kconfig
#
# Copyright (c) 2021 IoTerop
# 
#

menu "NEBRASKA client sample"

config NEBRASKA_SERVER_HOSTNAME
	string "CoAP server hostname"
	default "ingress.nebraska.ioterop.com"

config NEBRASKA_SERVER_PORT
	int "NEBRASKA server port"
	default 18834

config NEBRASKA_DEMO_TOPIC
	string "MQTT publish topic"
	default "/demo/test_1"

config NEBRASKA_DEMO_CLIENT
	string "NEBRASKA client"
	default "Nebraska_client_1"

config COAP_DTLS_SUPPORT
	bool "CoAP DTLS support"
	default y

config NEBRASKA_DEMO_PSK_IDENTITY
	depends on COAP_DTLS_SUPPORT
	string "NEBRASKA demo PSK identity"
	default "MqttIdentity"

config NEBRASKA_DEMO_PSK_KEY
	depends on COAP_DTLS_SUPPORT
	string "NEBRASKA demo PSK key"
	default "abcdef"

endmenu

menu "Zephyr Kernel"
source "Kconfig.zephyr"
endmenu
```

## nrf9160dk/sample.yaml
```yaml
sample:
  name: nRF9160DK Nebraska client
tests:
  samples.nrf9160.nebraska_client:
    build_only: true
    build_on_all: true
    platform_allow: nrf9160dk_nrf9160ns
    tags: ci_build
```
